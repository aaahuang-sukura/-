/*****************************************************************************
* 文件名：DS18B20.c
* 说  明：操作以DS18B20为代表的单总线通信的基本函数
*****************************************************************************/
#include "main.h"
#include "delay.h"

sbit DQ = P3^7;			// 数据通信线DQ


/******************************************************
* 函  数： 初始化DS18B20（产生复位脉冲、等待应答信号）
* 参  数：空
* 返回值：无
******************************************************/
void master_reset(void)
{
	uint i = 0;

	DQ = 1;
	DQ = 0;
	delay_us(80);	//拉低480~960us,这里大该80*9+10us	
	//for(i=100; i>0; i--);
	DQ = 1;			// 产生上升沿

	i = 20;
	while(DQ == 1)	//上升沿，等待应答信号（15~60us）
	{		
		if(i-- == 0)
			break;
	}

	i = 100;
	while(DQ == 0)	//应答信号 60~240um
	{
		if(i-- == 0)
			break;
	}
	delay_us(5);	//短暂延时
	DQ = 1;	
}

/******************************************************
* 函  数：读取数据的一个位（满足读时隙要求）
* 参  数：空
* 返回值：读到的数据位
******************************************************/
bit sing_read_bit(void)
{
	bit b = 0;

	DQ = 0;			//把总线拉低，低电平延时大于1us
	_nop_();
	DQ = 1;			//释放低电平，等待DS18B20输出数据
	delay_us(1);	//延时15us以上，读时隙下降沿后15us，DS18B20输出数据才有效
	b = DQ;
	delay_us(5);	//延时大于45us(5*9+8us)
	return (b);
}

/******************************************************
* 函  数：读取数据的一个字节
* 参  数：空
* 返回值：读到的数据
******************************************************/
uchar sing_read_byte(void)
{
	uchar i,j,b;
	b = 0;
	for (i=1; i<=8; i++)
	{
		j = sing_read_bit();
		b = (j<<7)|(b>>1);
	}
	return(b);
}

/******************************************************
* 函  数：写一个字节数据（注意写0和写1的时序）
* 参  数：b要写的数据
* 返回值：无
******************************************************/
void sing_write_byte(uchar b)
{
	uint i;
	uchar j;
	bit btmp;
	for(j=1;j<=8;j++)
	{
		btmp = b&0x01;
		b = b>>1;		// 取下一位（由低位向高位）
		if (btmp)
		{
			/* 写1 */
			DQ = 0;
			i++;i++;	// 延时，使得15us以内拉高
			DQ = 1;
			i = 8;
			while(i>0) i--;	// 整个写1时隙不低于60us 
	   	}
		else
		{
			/* 写0 */
			DQ = 0;			
			i = 8;
			while(i>0) i--;	// 保持低在60us到120us之间
			DQ = 1;
			i++;
			i++;
		}
	}
}

/******************************************************
* 函  数：启动温度转换
* 参  数：空
* 返回值：无
******************************************************/
void temper_convert(void)
{
	EA = 0;
	master_reset();				//初始化DS18B20（产生复位脉冲、等待应答信号） 
	sing_write_byte(0xCC);		// skip rom 命令
	sing_write_byte(0x44);		// convert T 命令
	EA = 1;
}

/******************************************************
* 函  数：读取温度值
* 参  数：pbuff[0]保存整数位，pbuff[1]保存小数
* 返回值：无
******************************************************/
void read_temper(uchar *pbuff)
{
	uchar tplsb,tpmsb;

	EA = 0;
	master_reset();				//初始化DS18B20（产生复位脉冲、等待应答信号） 
	sing_write_byte(0xCC);		// skip rom 命令
	sing_write_byte(0xBE);		// read scratchpad 命令
	tplsb = sing_read_byte();	// 温度值低位字节（其中低4位为二进制的“小数”部分）
	tpmsb = sing_read_byte();	// 高位值高位字节（其中高5位为符号位）
	EA = 1;		

	*pbuff = (tpmsb<<4)|(tplsb>>4);
	*(pbuff+1) = (tplsb&0x0F);	
}